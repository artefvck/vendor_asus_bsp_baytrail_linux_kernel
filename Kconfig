## Kconfig
```kconfig
#
# For a description of the syntax of this configuration file,
# see Documentation/kbuild/kconfig-language.txt.
#
mainmenu "Linux/$ARCH $KERNELVERSION Kernel Configuration"

config SRCARCH
	string
	option env="SRCARCH"
#jevian ma add for FACTORY ITEMS +
config FACTORY_ITEMS
	bool "Add for factory test"
	default n
	help
	This adds an option to enable factory test
#jevian ma add for FACTORY ITEMS -	
source "arch/$SRCARCH/Kconfig"
```

## drivers/input/sensor/Kconfig
```kconfig
#
# Sensor driver configuration
#
menuconfig INPUT_SENSOR
	bool "Sensor"

if INPUT_SENSOR

config INPUT_SENSOR_AK09911
	tristate "AK09911 compass support"
	default n
	depends on I2C
	help
	  If you say yes here you get support for Asahi Kasei's
	  orientation sensor AK09911.

config INPUT_SENSOR_KXTJ2
	tristate "Kionix KXTJ2 tri-axis digital accelerometer"
        default n
	depends on I2C
	help
	  Say Y here to enable support for the Kionix KXTJ2 digital tri-axis
	  accelerometer.

	  To compile this driver as a module, choose M here: the module will
	  be called kxtj2.

config INPUT_SENSOR_KXTJ2_POLLED_MODE
	bool "Enable polling mode support"
        default n
	depends on INPUT_KXTJ2
	select INPUT_POLLDEV
	help
	  Say Y here if you need accelerometer to work in polling mode.


config INPUT_SENSOR_HALLSENSOR
        bool "Hall sensor support"
        default n

endif
```

## drivers/power/ug31xx/Kconfig
```kconfig
config PRO_K011_GAUGE
        bool "k011 product gauge"
        default n
        help
          k011 product gauge

config PRO_K013_GAUGE
        bool "K013 product gauge"
        default n
        help
          K013 product gauge
```
